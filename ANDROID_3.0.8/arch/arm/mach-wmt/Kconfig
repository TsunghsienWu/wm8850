## ANDROID_3.0.8/arch/arm/mach-wmt/Kconfig
```kconfig
if ARCH_WMT

menu "WonderMedia Technology Implementations"

config WMT_EVB
        bool "WonderMedia Technology Evaluation Board"
        depends on ARCH_WMT
        default y
	---help---
	  Say Y here if you want to config the WonderMedia Technology specific parameters.

choice
	prompt "Select WonderMedia Technology evaluation board type"
	depends on WMT_EVB
	default WM0001
	---help---
	  Choose the type of WonderMedia Technology evaluation board type.
	  There are four types of WonderMedia Technology EVB, depend on the mounted components.

config WM0001
	bool "WM0001"
	---help---
	  Say Y here if you intend to build kernel on VT9043A1.

endchoice

config WMT_USE_BOOTLOADER_ATAG
	bool "Bootloader kernel parameter support"
	depends on WMT_EVB
	---help---
	Say Y here if you want to use kernel parameters passed from the arm bootloader.

config WMT_FIXUP_ATAG
	bool "Force to fixup kernel parameter"
	depends on WMT_EVB && WMT_USE_BOOTLOADER_ATAG
	---help---
	  Say Y here if you want to fixup the WonderMedia Technology kernel boot parameters.
	  It is a temp solution if ATAG passing have problem or you don't 
	  know how exactly setup kernel parameters.
	  
endmenu

endif
```

## ANDROID_3.0.8/drivers/i2c/chips/Kconfig
```kconfig
#
# Miscellaneous I2C chip drivers configuration
#
# *** DEPRECATED! Do not add new entries! See Makefile ***
#

menu "Miscellaneous I2C Chip support"

config WMT_I2C_API
    tristate "WMT I2C Device driver API"
    depends on I2C && ARCH_WMT
	help
	This module export i2c read/write API for other modules

endmenu
```

## ANDROID_3.0.8/drivers/input/sensor/Kconfig
```kconfig
#
# WMT Sensor configuration
#
menuconfig INPUT_SENSOR
	bool "WMT Sensor"
	default y
	help
	  Say Y here, and a list of supported sensor will be displayed.
	  This option doesn't affect the kernel.

	  If unsure, say Y.

if INPUT_SENSOR

config WMT_SENSOR_KXTE9
	tristate "KXTE9 G-Sensor Support"
	depends on ARCH_WMT
	default n
	help
	  Say Y here if you have an WMT based board with g-sensor 
	  attached to it.

	  If unsure, say N.

	  To compile this driver as a module, choose M here: the
	  module will be called s_wmt_gsensor_mc3230.
config WMT_SENSOR_MC3230
	tristate "Mcube MC3230 G-Sensor Support"
	depends on ARCH_WMT
	default y
	help
	  Say Y here if you have an WMT based board with g-sensor 
	  attached to it.

	  If unsure, say N.

	  To compile this driver as a module, choose M here: the
	  module will be called sensor_kxte9.

config WMT_SENSOR_DMARD08
	tristate "DMARD08 G-Sensor Support"
	depends on ARCH_WMT
	default y
	help
	  Say Y here if you have an WMT based board with g-sensor 
	  attached to it.

	  If unsure, say N.

	  To compile this driver as a module, choose M here: the
	  module will be called sensor_dmard08.
config WMT_SENSOR_DMARD06
	tristate "DMARD06 G-Sensor Support"
	depends on ARCH_WMT
	default y
	help
	  Say Y here if you have an WMT based board with g-sensor 
	  attached to it.

	  If unsure, say N.

	  To compile this driver as a module, choose M here: the
	  module will be called sensor_dmard06.
config WMT_SENSOR_DMARD10
	tristate "DMARD10 G-Sensor Support"
	depends on ARCH_WMT
	default y
	help
	  Say Y here if you have an WMT based board with g-sensor 
	  attached to it.

	  If unsure, say N.

	  To compile this driver as a module, choose M here: the
	  module will be called sensor_dmard10.
config WMT_SENSOR_MXC622X
	tristate "MXC622X G-Sensor Support"
	depends on ARCH_WMT
	default y
	help
	  Say Y here if you have an WMT based board with g-sensor 
	  attached to it.

	  If unsure, say N.

	  To compile this driver as a module, choose M here: the
	  module will be called sensor_mxc622x.
config WMT_SENSOR_MMA7660
	tristate "MMA7660 G-Sensor Support"
	depends on ARCH_WMT
	default y
	help
	  Say Y here if you have an WMT based board with g-sensor 
	  attached to it.

	  If unsure, say N.

	  To compile this driver as a module, choose M here: the
	  module will be called sensor_mma7660.
config WMT_SENSOR_ISL29023
	tristate "ISL29023 Light sensor Support"
	depends on ARCH_WMT
	default y
	help
	  Say Y here if you have an WMT based board with l-sensor 
	  attached to it.

	  If unsure, say N.

	  To compile this driver as a module, choose M here: the
	  module will be called sensor_isl29023.
config WMT_SENSOR_CM3232
	tristate "CM3232 Light sensor Support"
	depends on ARCH_WMT
	default y
	help
	  Say Y here if you have an WMT based board with l-sensor 
	  attached to it.

	  If unsure, say N.

	  To compile this driver as a module, choose M here: the
	  module will be called sensor_cm3232.
config WMT_SENSOR_STK3310
	tristate "STK3310 Light sensor Support"
	depends on ARCH_WMT
	default y
	help
	  Say Y here if you have an WMT based board with l-sensor 
	  attached to it.

	  If unsure, say N.

	  To compile this driver as a module, choose M here: the
	  module will be called sensor_stk3310.
	 
endif
```

## ANDROID_3.0.8/drivers/input/touchscreen/ft5x0x/Kconfig
```kconfig
config TOUCHSCREEN_FT5X0X
        tristate "FT5X0X Capacity Touchscreen Device Support"
        default y
        depends on ARCH_WMT
        ---help---
          Say Y here if you have an WMT based board with touchscreen
          attached to it.
          If unsure, say N.
          To compile this driver as a module, choose M here: the
          module will be called ft5x0x.
```

## ANDROID_3.0.8/drivers/input/touchscreen/novatek/Kconfig
```kconfig
config TOUCHSCREEN_NOVATEK
        tristate "Novatek Series Capacity Touchscreen Device Support"
        default m
        depends on ARCH_WMT
        ---help---
          Say Y here if you have an WMT based board with touchscreen
          attached to it.
          If unsure, say N.
          To compile this driver as a module, choose M here: the
          module will be called novatek.
```

## ANDROID_3.0.8/drivers/input/touchscreen/sitronix/Kconfig
```kconfig
config TOUCHSCREEN_SITRONIX
        tristate "Sitronix ST1xx series Capacity Touchscreen Device Support"
        default m
        depends on ARCH_WMT
        ---help---
          Say Y here if you have an WMT based board with touchscreen
          attached to it.
          If unsure, say N.
          To compile this driver as a module, choose M here: the
          module will be called s_wmt_ts_sitronix.ko.
```

## ANDROID_3.0.8/drivers/input/touchscreen/zet6221_ts/Kconfig
```kconfig
#
# ZET6221 capacity touch screen driver configuration
#
config TOUCHSCREEN_ZET6221
	tristate "ZEITEC ZET6221 I2C Capacitive Touchscreen Input Driver Support"
	depends on ARCH_WMT
	default y
	help
	  Say Y here if you have an WMT based board with touchscreen
	  attached to it.

	  If unsure, say N.

	  To compile this driver as a module, choose M here: the
	  module will be called s_wmt_ts_zet6221
```

## ANDROID_3.0.8/drivers/media/Kconfig
```kconfig
#
# Multimedia device configuration
#

menuconfig MEDIA_SUPPORT
	tristate "Multimedia support"
	depends on HAS_IOMEM
	help
	  If you want to use Video for Linux, DVB for Linux, or DAB adapters,
	  enable this option and other options below.

if MEDIA_SUPPORT

comment "Multimedia core support"

#
# Media controller
#

config MEDIA_CONTROLLER
	bool "Media Controller API (EXPERIMENTAL)"
	depends on EXPERIMENTAL
	---help---
	  Enable the media controller API used to query media devices internal
	  topology and configure it dynamically.

	  This API is mostly used by camera interfaces in embedded platforms.

#
# V4L core and enabled API's
#

config VIDEO_DEV
	tristate "Video For Linux"
	---help---
	  V4L core support for video capture and overlay devices, webcams and
	  AM/FM radio cards.

	  This kernel includes support for the new Video for Linux Two API,
	  (V4L2).

	  Additional info and docs are available on the web at
	  <http://linuxtv.org>

	  Documentation for V4L2 is also available on the web at
	  <http://bytesex.org/v4l/>.

	  To compile this driver as a module, choose M here: the
	  module will be called videodev.

config VIDEO_V4L2_COMMON
	tristate
	depends on (I2C || I2C=n) && VIDEO_DEV
	default (I2C || I2C=n) && VIDEO_DEV

config VIDEO_V4L2_SUBDEV_API
	bool "V4L2 sub-device userspace API (EXPERIMENTAL)"
	depends on VIDEO_DEV && MEDIA_CONTROLLER && EXPERIMENTAL
	---help---
	  Enables the V4L2 sub-device pad-level userspace API used to configure
	  video format, size and frame rate between hardware blocks.

	  This API is mostly used by camera interfaces in embedded platforms.

#
# DVB Core
#

config DVB_CORE
	tristate "DVB for Linux"
	depends on NET && INET
	select CRC32
	help
	  DVB core utility functions for device handling, software fallbacks etc.

	  Enable this if you own a DVB/ATSC adapter and want to use it or if
	  you compile Linux for a digital SetTopBox.

	  Say Y when you have a DVB or an ATSC card and want to use it.

	  API specs and user tools are available from <http://www.linuxtv.org/>.

	  Please report problems regarding this support to the LinuxDVB
	  mailing list.

	  If unsure say N.

config VIDEO_MEDIA
	tristate
	default (DVB_CORE && (VIDEO_DEV = n)) || (VIDEO_DEV && (DVB_CORE = n)) || (DVB_CORE && VIDEO_DEV)

comment "Multimedia drivers"

source "drivers/media/common/Kconfig"
source "drivers/media/rc/Kconfig"

#
# Tuner drivers for DVB and V4L
#

source "drivers/media/common/tuners/Kconfig"

#
# Video/Radio/Hybrid adapters
#

source "drivers/media/video/Kconfig"

source "drivers/media/radio/Kconfig"

#
# DVB adapters
#

source "drivers/media/dvb/Kconfig"

config WMT_VIDEO_DECODE
	tristate "WonderMedia Video Decoder"
	---help---
	  Say Y here to use WonderMedia hardware decoder to decode video

menu "WonderMedia Video Decoder"
	depends on WMT_VIDEO_DECODE
source "drivers/media/video/wmt/mpeg2/Kconfig"
source "drivers/media/video/wmt/mpeg4/Kconfig"
source "drivers/media/video/wmt/divx/Kconfig"
source "drivers/media/video/wmt/h263/Kconfig"
source "drivers/media/video/wmt/h264/Kconfig"
source "drivers/media/video/wmt/rv/Kconfig"
source "drivers/media/video/wmt/vc1/Kconfig"
source "drivers/media/video/wmt/vpx/Kconfig"
source "drivers/media/video/wmt/jpeg/Kconfig"
source "drivers/media/video/wmt/Kconfig"
endmenu

config WMT_VIDEO_ENCODE
	tristate "WonderMedia Video Encoder"
	---help---
	  Say Y here to use WonderMedia hardware decoder to decode video

menu "WonderMedia HW Video Encoder"
	depends on WMT_VIDEO_ENCODE
source "drivers/media/video/wmt/encode/h264/Kconfig"
endmenu

config WMT_V4L2
	tristate "WonderMedia V4L2"
	---help---
	  Say Y here to use WonderMedia V4L2

menu "WonderMedia V4L2"
	depends on WMT_V4L2
source "drivers/media/video/wmt_v4l2/cmos/Kconfig"
source "drivers/media/video/wmt_v4l2/tv_decoder/Kconfig"

endmenu

endif # MEDIA_SUPPORT
```

## ANDROID_3.0.8/drivers/media/video/wmt/vpx/Kconfig
```kconfig
#
# Multimedia Video device configuration
#

config WMT_VIDEO_DECODE_VPX
	tristate "WonderMedia Hardware VPX decoder"
	---help---
	  Say Y here to use hardware to decode VPX files
```

## ANDROID_3.0.8/drivers/misc/viatel/Kconfig
```kconfig
menu "Viatelecom OEM funtion support"

config VIATELECOM_SYNC_CBP
	bool "Ap Sync Cbp"
	help
      The synchronous mechanism for the data exchage between Ap and Cbp.

config VIATELECOM_POWER_CBP
	bool "AP Power Cbp"
	help
	  Enable this driver to support to control funtion such as reset, power
	  between AP and Cbp.

endmenu
```

## ANDROID_3.0.8/drivers/misc/wmt/Kconfig
```kconfig
menu "WMT EBM Controller "
config WMT_EBM
	tristate "EBM"
	help
	  This enables the shared transport core driver for WMT
	  EBM drivver. 
endmenu
```

## ANDROID_3.0.8/drivers/misc/wmtswitch/Kconfig
```kconfig
#
# ZET6221 capacity touch screen driver configuration
#
config WMT_SWITCH
	tristate "WMT GPIO Switch Support"
	depends on ARCH_WMT
	default y
	help
	  Say Y here if you have an WMT based board with switch
	  attached to it.

	  If unsure, say N.

	  To compile this driver as a module, choose M here: the
	  module will be called wmt_switch
```

## ANDROID_3.0.8/drivers/test_skeleton/Kconfig
```kconfig
menuconfig TEST_SKELETON
	bool "test skeleton"
	help
	  Say Y here to get to see options for device drivers from various
	  different categories. This option alone does not add any kernel code.
	  If you say N, all options in this submenu will be skipped and disabled.
	  
if TEST_SKELETON

config GPIO_TEST
	tristate "TEST GPIO API"
	help
	  verify this gpio api is ok or not.
	  you should have hardware test enviroment,for example you can
	  measure specific gpio pin by multimeter with echo xx > /proc/test command together

	  
endif
```

## ANDROID_3.0.8/drivers/usb/gadget/serial/Kconfig
```kconfig
#
# usb tty configuration
#
config USB_GADGET_SERIAL
	tristate "Enable usb tty"
	depends on USB_GADGET
	help
	  Enable the device-side support for usb tty
```

## ANDROID_3.0.8/sound/soc/wmt/Kconfig
```kconfig
config SND_WMT_SOC
	bool "SoC Audio for the WMT chip"
	depends on ARCH_WMT && SND && SND_SOC
	help
	  Say Y or M if you want to add support for codecs attached to
	  the WMT AC97, I2S interface. You will also need
	  to select the audio interfaces to support below.

#
# WMT ALSA I2S driver
#
config SND_WMT_SOC_I2S
        bool "SoC I2S Audio support for WMT"
        depends on SND_WMT_SOC
        ---help---
          Say Y or M if you want to add support for codecs attached to
	  		the WMT I2S interface.
	  		
config SND_WMT_SOC_PDM
        bool "SoC PDM Audio Interface support for WMT"
        depends on SND_WMT_SOC
        ---help---
          Say Y or M if you want to add support for codecs attached to
	  		the WMT PDM interface.

config I2S_HW_DAC
        bool "HW_DAC"
        depends on SND_WMT_SOC_I2S
        select SND_SOC_HWDAC
        ---help---
          Say Y here if you want to use HW DAC.
          	  		
config I2S_CODEC_VT1602
        bool "VT1602"
        depends on SND_WMT_SOC_I2S
        select SND_SOC_VT1602
        ---help---
          Say Y here if you want to use VT1602 as the I2S Codec.
          
config I2S_CODEC_WM8900
        bool "WM8900"
        depends on SND_WMT_SOC_I2S
        select SND_SOC_WM8900
        ---help---
          Say Y here if you want to use WM8900 as the I2S Codec.
          
config I2S_CODEC_WM8994
        bool "WM8994"
        depends on SND_WMT_SOC_I2S
        select SND_SOC_WM8994
        ---help---
          Say Y here if you want to use WM8994 as the I2S Codec.
          
config I2S_CODEC_VT1603
        bool "VT1603"
        depends on SND_WMT_SOC_I2S
        select SND_SOC_VT1603
        ---help---
          Say Y here if you want to use VT1603 as the I2S Codec.

config ECHO_CANCELLATION_FM34
        tristate "FM34"
        select SND_SOC_WMT_FM34
        ---help---
          Say Y here if you want to use fm34 to echo cancallation. 
```
